/*
 * Copyright (c) 2025 Core Devices LLC
 * SPDX-License-Identifier: Apache-2.0
 */

/* Temporary SF32LB57X bring-up reuses the SF32LB52 DevKit pinout. */
#include "../sf32lb52_devkit_lcd/sf32lb52_devkit_lcd-pinctrl.dtsi"